## meta-xen-domd/conf/machine/include/rcar_gen4_common.inc
```bitbake
#SOC_FAMILY =. "rcar-gen4:"
SOC_FAMILY =. "rcar:rcar-v4x:"

require conf/machine/include/rcar_common.inc

IMAGE_FSTYPES += " ext4"
```

## meta-xen-domd/conf/machine/sparrow-hawk.conf
```bitbake
#@TYPE: Machine
#@NAME: Sparrow hawk machine
#@DESCRIPTION: Machine configuration for running sparrow-hawk

SOC_FAMILY = "r8a779g3"
require conf/machine/include/rcar_gen4_common.inc

DEFAULTTUNE ?= "cortexa76"
require conf/machine/include/arm/armv8-2a/tune-cortexa76.inc

# Device tree
KERNEL_DEVICETREE = "\
    renesas/r8a779g3-sparrow-hawk.dtb \
"

# u-boot configure
UBOOT_MACHINE = "r8a779g3_sparrowhawk_defconfig"


# Set Image & SDK name for V4H
IMAGE_NAME = "${IMAGE_BASENAME}-${MACHINE}${IMAGE_VERSION_SUFFIX}"
IMAGE_LINK_NAME = "${IMAGE_BASENAME}-${MACHINE}"
SDK_NAME:r8a779g3 = "${DISTRO}-${TCLIBC}-${SDKMACHINE}-${IMAGE_BASENAME}-${TUNE_PKGARCH}-${MACHINE}"

PREFERRED_PROVIDER_virtual/egl = "${@bb.utils.contains('MACHINE_FEATURES', 'gsx', 'gles-user-module', '', d)}"
PREFERRED_PROVIDER_virtual/libgles2 = "${@bb.utils.contains('MACHINE_FEATURES', 'gsx', 'gles-user-module', '', d)}"
BBMASK += "${@bb.utils.contains('MACHINE_FEATURES', 'gsx', '', 'meta-renesas/meta-rcar-adas/recipes-graphics/mesa/ \
                                meta-renesas/meta-rcar-adas/recipes-kernel/kernel-module-gles/ \
                                meta-renesas/meta-rcar-adas/recipes-graphics/gles-user-module/', d)}"
```
